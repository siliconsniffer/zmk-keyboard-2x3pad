/*
 * SPDX-License-Identifier: MIT
 *
 * Device Tree Overlay for a 2x3 keyboard shield.
 */

#include <dt-bindings/zmk/matrix_transform.h>
#include "2x3pad-layouts.dtsi"

/ {
    kscan0: kscan {
        compatible = "zmk,kscan-gpio-matrix";
        label = "KSCAN";
        diode-direction = "col2row";
        row-gpios = <&xiao_d 2 (GPIO_ACTIVE_HIGH | GPIO_PULL_DOWN)>,
                    <&xiao_d 3 (GPIO_ACTIVE_HIGH | GPIO_PULL_DOWN)>;
        col-gpios = <&xiao_d 4 (GPIO_ACTIVE_HIGH)>,
                    <&xiao_d 5 (GPIO_ACTIVE_HIGH)>,
                    <&xiao_d 6 (GPIO_ACTIVE_HIGH)>;
    };

    default_transform: keymap_transform_0 {
        compatible = "zmk,matrix-transform";
        rows = <2>;
        columns = <3>;
        map = <RC(0,0) RC(0,1) RC(0,2) RC(1,0) RC(1,1) RC(1,2)>;
    };

    physical_layout0: physical_layout_0 {
        compatible = "zmk,physical-layout";
        display-name = "Default Layout";
        kscan = <&kscan0>;
        transform = <&default_transform>;
        keys = <&2x3pad_physical_layout>;
    };
};
