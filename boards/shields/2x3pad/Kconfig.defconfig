## boards/shields/2x3pad/Kconfig.defconfig
```kconfig
# Copyright (c) 2020 The ZMK Contributors
# SPDX-License-Identifier: MIT

if SHIELD_2X3PAD

config ZMK_KEYBOARD_NAME
    default "3x4pad"

endif
```

## boards/shields/2x3pad/Kconfig.shield
```kconfig
# Copyright (c) 2020 The ZMK Contributors
# SPDX-License-Identifier: MIT

config SHIELD_2X3PAD
    def_bool $(shields_list_contains,2x3pad)
```
